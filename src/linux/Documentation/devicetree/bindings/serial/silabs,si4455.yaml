## src/linux/Documentation/devicetree/bindings/serial/silabs,si4455.yaml
```yaml
# SPDX-License-Identifier: (GPL-2.0-only OR BSD-2-Clause)
%YAML 1.2
---
$id: "http://devicetree.org/schemas/serial/silabs,si4455.yaml#"
$schema: "http://devicetree.org/meta-schemas/core.yaml#"

title: Silicon Labs Si4455 device tree bindings

maintainers:
  - József Horváth <info@ministro.hu>

description:
  This document is for describing the required device tree parameters for si4455 serial driver.
  The si4455 driver tries to represent the Silicon Labs Si4455 sub-GHz transceiver device
  like a serial port. The required parameters for proper operation are described below.
  https://www.silabs.com/documents/public/data-sheets/Si4455.pdf

allOf:
  - $ref: "serial.yaml#"

properties:
  compatible:
    const: silabs,si4455

  reg:
    maxItems: 1

  interrupts:
    maxItems: 1

  spi-max-frequency:
    description: maximum clock frequency on SPI port
    maximum: 500000

  shutdown-gpios:
    description: gpio pin for SDN
    maxItems: 1

  silabs,package-size:
    description:
      Radio payload length, variable packet length is not supported by driver.
      This value should equal with EZConfig payload length.
    $ref: /schemas/types.yaml#/definitions/uint32
    maximum: 64
    minimum: 1

  silabs,tx-channel:
    description:
      Radio transmit channel selection.
    $ref: /schemas/types.yaml#/definitions/uint32
    maximum: 255
    minimum: 0

  silabs,rx-channel:
    description:
      Radio receive channel selection.
    $ref: /schemas/types.yaml#/definitions/uint32
    maximum: 255
    minimum: 0

  silabs,tx-timeout:
    description:
      Radio transmit timeout(ms)
    $ref: /schemas/types.yaml#/definitions/uint32
    maximum: 1000
    minimum: 1

  firmware-name:
    description:
      Radio configuration data file name.
    $ref: /schemas/types.yaml#/definitions/string
    items:
      pattern: ^[0-9a-z\._\-]{1,255}$

required:
  - reg
  - interrupts
  - spi-max-frequency
  - shutdown-gpios
  - silabs,package-size
  - silabs,tx-channel
  - silabs,rx-channel
  - firmware-name

additionalProperties: false

examples:
  - |
    spi {
      #address-cells = <1>;
      #size-cells = <0>;
      si4455_0: serial@0 {
        compatible = "silabs,si4455";
        reg = <0>;
        interrupt-parent = <&gpio>;
        interrupts = <7 2>;
        shutdown-gpios = <&gpio 26 1>;
        spi-max-frequency = <300000>;
        silabs,package-size = <30>;
        silabs,tx-channel = <1>;
        silabs,rx-channel = <2>;
        firmware-name = "si4455_spi0_0.ez.bin";
      };
    };
...
```
